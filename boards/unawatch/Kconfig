## boards/unawatch/Kconfig
```kconfig
# SPDX-FileCopyrightText: 2026 Core Devices LLC
# SPDX-License-Identifier: Apache-2.0

config BOARD_UNAWATCH
    bool
    default y
    select GPIO
    help
      The UNA Watch. The board drives the enables of its loads to their
      off level at boot, as some must not float, which takes the GPIO
      class.

if BOARD_UNAWATCH

config BOARD_UNAWATCH_CONSOLE_DAM
    bool "Console on the USB-C connector"
    default y if !RELEASE
    help
      Drive USB_DAM (PB15) high at boot, which routes the USART3 console
      to the USB-C connector, for a Type-C debug accessory adapter. The
      stock firmware only does so once the STUSB4500 reports a debug
      accessory; without one attached, the console line stays wired to
      the connector.

config BOARD_UNAWATCH_TETHER_SLOT
    bool "Link for the slot of the tether stub"
    help
      Link the image at 0x08080000 instead of 0x08060000, for the slot
      the tether stub (tools/una/tether) programs over USB and starts:
      the stub stays where the bootloader starts images. Such an image
      is flashed with `tether.py flash`, not packed as an .ota.

config BOARD_UNAWATCH_LAB
    bool
    default y if "$(BOARD_VARIANT)" = "lab"
    help
      The experiments firmware, the board's lab variant (unawatch/lab):
      it starts as the first port did, which boots, with the storage in
      the embedded flash, the system resources in the image, the eMMC
      unused at boot and no battery drivers, and carries the Lab app to
      run experiments on the eMMC, the clocks and the reset causes.

endif # BOARD_UNAWATCH
```

## drivers/bt_hci/Kconfig
```kconfig
# SPDX-FileCopyrightText: 2026 The unapebble authors
# SPDX-License-Identifier: Apache-2.0

menuconfig BT_HCI
    bool "Bluetooth HCI controllers"
    help
      Bluetooth controllers on a bus (pbl/drivers/bt_hci.h), described for
      the HCI transport that drives them, which selects this.

if BT_HCI

config BT_HCI_BLUENRG2
    bool "ST BlueNRG-2 on SPI"
    default y
    depends on DT_HAS_ST_BLUENRG_2_ENABLED
    select GPIO
    select SPI
    help
      The pins and SPI device of a BlueNRG-2 running ST's DTM firmware,
      for the NimBLE transport that drives it (NIMBLE_HCI_BLUENRG2).

endif # BT_HCI
```

## drivers/charger/Kconfig
```kconfig
# SPDX-FileCopyrightText: 2026 Core Devices LLC
# SPDX-FileCopyrightText: 2026 The unapebble authors
# SPDX-License-Identifier: Apache-2.0

menuconfig CHARGER
    bool "Charger"
    help
      Battery charger class (pbl/drivers/charger.h).

if CHARGER

config CHARGER_SHELL
    bool "Shell commands"
    default DRIVER_SHELL
    depends on SHELL
    help
      The charger shell command, to show whether external power is
      present, the charge status and the battery measurements.

config CHARGER_HIGH_LOAD
    bool
    help
      The charger driver limits the discharge current, and lifts the
      limit on pbl_charger_high_load_request().

config CHARGER_NPM1300
    bool "Nordic nPM1300"
    default y
    depends on DT_HAS_NORDIC_NPM1300_ENABLED
    select CHARGER_HIGH_LOAD
    select GPIO
    select KERNEL_SYS_WORKQ
    select KERNEL_SYS_WORKQ_HIGH
    select MFD
    select MFD_NPM1300
    help
      Support for the charger of the Nordic nPM1300 PMIC.

config CHARGER_PCA9420
    bool "NXP PCA9420"
    default y
    depends on DT_HAS_NXP_PCA9420_ENABLED
    select I2C
    select KERNEL_SYS_WORKQ
    select KERNEL_SYS_WORKQ_HIGH
    select PINCTRL
    help
      Support for the linear charger of the NXP PCA9420 PMIC. The
      regulators of the PMIC are left as they are.

config CHARGER_PCA9420_CHARGE_LIMIT_MV
    int "Charge voltage limit (mV)"
    range 0 4600
    default 0
    depends on CHARGER_PCA9420
    help
      0 charges to the constant-charge-voltage of the battery. A lower
      voltage stops the charge short of full, for a longer battery life:
      4100 charges a 4.4 V cell to about 75 to 80%. The battery's voltage
      is never exceeded.

config CHARGER_SIM
    bool "Simulator"
    default y if SOC_QEMU_PEBBLE || SOC_POSIX
    help
      Simulated charger, set through its simulator API
      (pbl/drivers/charger/sim.h).
      On a board, a stand-in for hardware without a driver yet, which
      nothing feeds.

module = DRIVER_CHARGER
module-str = Charger
source "subsys/logging/Kconfig.template.log_level"

endif # CHARGER
```

## drivers/gauge/Kconfig
```kconfig
# SPDX-FileCopyrightText: 2026 Core Devices LLC
# SPDX-License-Identifier: Apache-2.0

menuconfig GAUGE
    bool "Fuel gauge"
    help
      Battery fuel gauge class (pbl/drivers/gauge.h): a chip that
      measures the battery and estimates its state of charge.

if GAUGE

config GAUGE_SHELL
    bool "Shell commands"
    default DRIVER_SHELL
    depends on SHELL
    help
      The gauge shell command, to read the fuel gauge.

config GAUGE_MAX17262
    bool "Maxim MAX17262"
    default y
    depends on DT_HAS_MAXIM_MAX17262_ENABLED
    select I2C
    help
      Support for the Maxim MAX17262 fuel gauge, with its internal
      sense resistor, on the ModelGauge m5 EZ model of the battery.

config GAUGE_MAX17262_FULL_SOC_THRESHOLD
    int "End-of-charge detection threshold (%)"
    range 0 100
    default 80
    depends on GAUGE_MAX17262
    help
      FullSOCThr: the gauge takes the end of a charge as a full battery
      only above this voltage-based state of charge. 80% is Maxim's
      recommendation for EZ models. A charger stopping short of full
      takes 95%, so that the gauge never learns a partial charge as the
      capacity of the cell.

module = DRIVER_GAUGE
module-str = Fuel gauge
source "subsys/logging/Kconfig.template.log_level"

endif # GAUGE
```

## drivers/gnss/Kconfig
```kconfig
# SPDX-FileCopyrightText: 2026 The unapebble authors
# SPDX-License-Identifier: Apache-2.0

menuconfig GNSS
    bool "GNSS receiver"
    help
      Satellite positioning receiver drivers (pbl/drivers/gnss.h). The
      board instantiates the receiver it has and exports it as GNSS.

if GNSS

config GNSS_SHELL
    bool "Shell commands"
    default DRIVER_SHELL || GNSS_SIM
    depends on SHELL
    help
      The gnss shell command, to start, stop and read the receiver, and
      to drive the simulator.

config GNSS_AG3335
    bool "Airoha AG3335"
    default y
    depends on DT_HAS_AIROHA_AG3335M_ENABLED
    depends on UART
    select GPIO
    help
      The Airoha AG3335 receivers on a UART, powered by an enable line:
      NMEA sentences, set up with the receiver's PAIR commands.

config GNSS_AG3335_DUAL_BAND
    bool "L1 and L5"
    depends on GNSS_AG3335
    help
      Receive the L5 band as well as L1 (PAIR104). Off, as UNA's
      firmware runs the receiver, on L1 alone.

config GNSS_AG3335_SLEEP
    bool "Let the receiver's system sleep"
    depends on GNSS_AG3335
    help
      Unlock the sleep of the receiver's own system (PAIR382,0) once it
      is set up. UNA's firmware keeps it locked on L1 alone.

config GNSS_SIM
    bool "Simulator"
    depends on SOC_QEMU_PEBBLE || SOC_POSIX
    help
      Simulated receiver, replaying a built-in looped running route at
      1 Hz, or the fixes set through its simulator API
      (pbl/drivers/gnss/sim.h).

config GNSS_REPLAY
    bool "Replay the simulator's route over a receiver"
    default y if !RELEASE
    depends on GNSS_SHELL && !GNSS_SIM
    help
      The gnss replay command: while on, every epoch of the real
      receiver is reported as a 3D fix on the simulator's route, one
      second along it, keeping the receiver's time, its power and its
      timing. For testing recorders indoors; off at every start.

config GNSS_SIM_TIME_TO_FIX
    int "Simulated time to first fix (s)"
    default 8
    depends on GNSS_SIM
    help
      Epochs without a position the simulator reports after it starts.

module = DRIVER_GNSS
module-str = GNSS receiver
source "subsys/logging/Kconfig.template.log_level"

endif # GNSS
```

## drivers/imu/Kconfig
```kconfig
# SPDX-FileCopyrightText: 2026 Core Devices LLC
# SPDX-License-Identifier: Apache-2.0

menu "IMU"

config IMU_SHELL
    bool "Shell commands"
    default DRIVER_SHELL
    depends on SHELL
    help
      The imu shell command, to read the accelerometer and magnetometer
      drivers directly.

menuconfig ACCEL
    bool "Accelerometer"
    help
      Accelerometer drivers (pbl/drivers/accel.h). The board instantiates
      the accelerometer it has and exports it as ACCEL.

if ACCEL

config ACCEL_BMI270
    bool "Bosch BMI270"
    default y
    depends on DT_HAS_BOSCH_BMI270_ENABLED
    select GPIO
    select I2C
    select KERNEL_SYS_WORKQ_HIGH
    help
      Support for the accelerometer of the Bosch BMI270 IMU, with
      Bosch's configuration file for its feature engine.

config ACCEL_LIS2DW12
    bool "ST LIS2DW12"
    default y
    depends on DT_HAS_ST_LIS2DW12_ENABLED
    select I2C
    select KERNEL_SYS_WORKQ_HIGH
    help
      Support for the ST LIS2DW12 accelerometer.

config ACCEL_LSM6DSO
    bool "ST LSM6DSO"
    default y
    depends on DT_HAS_ST_LSM6DSO_ENABLED
    select GPIO
    select I2C
    select KERNEL_SYS_WORKQ_HIGH
    help
      Support for the ST LSM6DSO accelerometer/gyroscope.

config ACCEL_SIM
    bool "Simulator"
    default y if SOC_QEMU_PEBBLE || SOC_POSIX
    select KERNEL_SYS_WORKQ_HIGH
    help
      Simulated accelerometer, replaying samples and events fed through
      its simulator API (pbl/drivers/imu/sim.h).
      On a board, a stand-in for hardware without a driver yet, which
      nothing feeds.

endif # ACCEL

if ACCEL_LIS2DW12

config ACCEL_LIS2DW12_WK_DUR_DEFAULT
    int "Default wake duration"
    range 0 3
    default 0
    help
      Default wake duration applied at init.

config ACCEL_LIS2DW12_WK_THS_MIN
    int "Minimum wake threshold"
    range 0 63
    default 0
    help
      Minimum (highest sensitivity) wake-up threshold.

config ACCEL_LIS2DW12_WK_THS_MAX
    int "Maximum wake threshold"
    range 0 63
    default 63
    help
      Maximum (lowest sensitivity) wake-up threshold.

config ACCEL_LIS2DW12_WK_THS_DEFAULT
    int "Default wake threshold"
    range 0 63
    default 0
    help
      Default wake-up threshold applied at init.

config ACCEL_LIS2DW12_SCALE_MG
    int "Full-scale range (mg)"
    default 2000
    help
      Acceleration full-scale range in mg (2000, 4000, 8000 or 16000).

endif # ACCEL_LIS2DW12

if ACCEL_LSM6DSO

config ACCEL_LSM6DSO_WK_DUR_DEFAULT
    int "Default wake duration"
    range 0 3
    default 0
    help
      Default wake duration applied at init.

config ACCEL_LSM6DSO_WK_THS_MIN
    int "Minimum wake threshold"
    range 0 63
    default 0
    help
      Minimum (highest sensitivity) wake-up threshold.

config ACCEL_LSM6DSO_WK_THS_MAX
    int "Maximum wake threshold"
    range 0 63
    default 63
    help
      Maximum (lowest sensitivity) wake-up threshold.

config ACCEL_LSM6DSO_WK_THS_DEFAULT
    int "Default wake threshold"
    range 0 63
    default 0
    help
      Default wake-up threshold applied at init.

config ACCEL_LSM6DSO_SCALE_MG
    int "Full-scale range (mg)"
    default 2000
    help
      Acceleration full-scale range in mg (2000, 4000, 8000 or 16000).

endif # ACCEL_LSM6DSO

if ACCEL_BMI270

config ACCEL_BMI270_SCALE_MG
    int "Full-scale range (mg)"
    default 4000
    help
      Acceleration full-scale range in mg (2000, 4000, 8000 or 16000).

config ACCEL_BMI270_AVG_LOG2
    int "Samples averaged, as a power of 2"
    range 0 7
    default 2
    help
      The low power mode's averaging, from 1 sample (0) to 128 (7): more
      samples, less noise and more current.

config ACCEL_BMI270_SHAKE_MIN_MG
    int "Shake threshold at the highest sensitivity (mg)"
    range 1 999
    default 32
    help
      Any-motion threshold at 100% shake sensitivity and in high
      sensitivity mode.

config ACCEL_BMI270_SHAKE_MAX_MG
    int "Shake threshold at the lowest sensitivity (mg)"
    range 2 999
    default 999
    help
      Any-motion threshold at 0% shake sensitivity.

config ACCEL_BMI270_SHAKE_DURATION
    int "Shake duration (20 ms samples)"
    range 1 8191
    default 2
    help
      Samples of the feature engine's 50 Hz above the threshold that
      make a shake.

endif # ACCEL_BMI270

menuconfig MAG
    bool "Magnetometer"
    help
      Magnetometer drivers (pbl/drivers/mag.h). The board instantiates
      the magnetometer it has and exports it as MAG.

if MAG

config MAG_BMM350
    bool "Bosch BMM350"
    default y
    depends on DT_HAS_BOSCH_BMM350_ENABLED
    select I2C
    select KERNEL_SYS_WORKQ_HIGH
    help
      Support for the Bosch BMM350 magnetometer.

config MAG_BMM350_AVG_LOG2
    int "Samples averaged, as a power of 2"
    depends on MAG_BMM350
    range 0 3
    default 2
    help
      Samples averaged in each measurement, from 1 (0) to 8 (3), reduced
      to what the ODR allows: more samples, less noise and more current.

config MAG_MMC5603NJ
    bool "MEMSIC MMC5603NJ"
    default y
    depends on DT_HAS_MEMSIC_MMC5603_ENABLED
    select I2C
    select KERNEL_SYS_WORKQ_HIGH
    help
      Support for the MEMSIC MMC5603NJ magnetometer.

config MAG_SIM
    bool "Simulator"
    depends on SOC_QEMU_PEBBLE || SOC_POSIX
    select KERNEL_SYS_WORKQ_HIGH
    help
      Simulated magnetometer, measuring a field set through its
      simulator API (pbl/drivers/imu/sim.h).

endif # MAG

module = DRIVER_IMU
module-str = IMU
source "subsys/logging/Kconfig.template.log_level"

endmenu
```

## drivers/mmc/Kconfig
```kconfig
# SPDX-FileCopyrightText: 2026 The unapebble authors
# SPDX-License-Identifier: Apache-2.0

menuconfig MMC
    bool "MMC"
    help
      MMC class (pbl/drivers/mmc.h) and its drivers: an eMMC soldered to
      the board, as a block device the class powers up on use and down
      once idle.

if MMC

config MMC_IDLE_OFF_MS
    int "Idle time before the card is powered down, in ms"
    default 2000
    help
      The card is powered down once it has had no access for this long,
      and powered up again, which takes some tens of milliseconds, by the
      next access. 0 keeps it powered.

config MMC_STM32_SDMMC
    bool "STM32 SDMMC"
    default y
    depends on DT_HAS_ST_STM32_SDMMC2_ENABLED
    select CLK
    select GPIO
    select PINCTRL
    select RESET
    help
      An eMMC on the SDMMC host of the STM32U5, polled, its data moved by
      the internal DMA of the host.

module = DRIVER_MMC
module-str = MMC
source "subsys/logging/Kconfig.template.log_level"

endif # MMC
```

## drivers/pressure/Kconfig
```kconfig
# SPDX-FileCopyrightText: 2026 Core Devices LLC
# SPDX-License-Identifier: Apache-2.0

menuconfig PRESSURE
    bool "Pressure sensor"
    help
      Barometric pressure sensor drivers (pbl/drivers/pressure.h). The
      board instantiates the sensor it has and exports it as PRESSURE.

if PRESSURE

config PRESSURE_SHELL
    bool "Shell commands"
    default DRIVER_SHELL
    depends on SHELL
    help
      The pressure shell command, to run one conversion.

config PRESSURE_BMP390
    bool "Bosch BMP380 and BMP390"
    default y
    depends on DT_HAS_BOSCH_BMP380_ENABLED
    select I2C
    help
      Support for the Bosch BMP380 and BMP390 barometric pressure sensors
      (devicetree compatible bosch,bmp380).

config PRESSURE_MS5837
    bool "TE Connectivity MS5837-02BA"
    default y
    depends on DT_HAS_MEAS_MS5837_ENABLED
    select I2C
    help
      Support for the TE Connectivity (Measurement Specialties) MS5837-02BA
      pressure sensor (devicetree compatible meas,ms5837).

config PRESSURE_MS5837_OSR
    int "Oversampling, as OSR 256 << n"
    depends on PRESSURE_MS5837
    range 0 5
    default 4
    help
      The oversampling of each conversion, from 256 (0) to 8192 (5): the
      default, 4096, takes 9 ms a conversion, two a read.

module = DRIVER_PRESSURE
module-str = Pressure sensor
source "subsys/logging/Kconfig.template.log_level"

endif # PRESSURE
```
