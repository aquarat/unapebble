## dts/bindings/display/jdi-parallel-gpio.yaml
```yaml
# SPDX-License-Identifier: (GPL-2.0-only OR BSD-2-Clause)
%YAML 1.2
---
$id: http://devicetree.org/schemas/display/jdi-parallel-gpio.yaml#
$schema: http://devicetree.org/meta-schemas/core.yaml#

title: JDI parallel interface on GPIO

maintainers:
  - Gerard Marull-Paretas <gerard@teslabs.com>

description:
  The JDI parallel interface of a memory-in-pixel panel, clocked on GPIO by
  the CPU for a SoC without a controller generating it. The panel, connected
  to its port, gives the timing, mounting rotation and round mask.

properties:
  compatible:
    const: jdi-parallel-gpio

  vst-gpios:
    maxItems: 1
    description: Vertical start pulse, VST (GSP).

  vck-gpios:
    maxItems: 1
    description: Vertical shift clock, VCK (GCK).

  enb-gpios:
    maxItems: 1
    description: Pixel memory write enable, ENB (GEN).

  xrst-gpios:
    maxItems: 1
    description: Driver reset, XRST (INTB), high for the length of a frame.

  hst-gpios:
    maxItems: 1
    description: Horizontal start pulse, HST (BSP).

  hck-gpios:
    maxItems: 1
    description: Horizontal shift clock, HCK (BCK).

  data-gpios:
    maxItems: 6
    minItems: 6
    description:
      R1, R2, G1, G2, B1 and B2, on one GPIO port, active high. R1, G1 and B1
      carry the even pixels, R2, G2 and B2 the odd ones.

  width:
    $ref: /schemas/types.yaml#/definitions/uint32
    description:
      Width of the framebuffer, at least that of the panel's image, which
      shows its centre. That of the image by default.

  height:
    $ref: /schemas/types.yaml#/definitions/uint32
    description: Height of the framebuffer, as width.

  port:
    $ref: /schemas/graph.yaml#/properties/port
    description: Connection to the panel.

required:
  - compatible
  - vst-gpios
  - vck-gpios
  - enb-gpios
  - xrst-gpios
  - hst-gpios
  - hck-gpios
  - data-gpios
  - port

additionalProperties: false
```

## dts/bindings/iio/magnetometer/bosch,bmm350.yaml
```yaml
# SPDX-License-Identifier: (GPL-2.0-only OR BSD-2-Clause)
%YAML 1.2
---
$id: http://devicetree.org/schemas/iio/magnetometer/bosch,bmm350.yaml#
$schema: http://devicetree.org/meta-schemas/core.yaml#

title: Bosch BMM350 3-axis magnetometer

maintainers:
  - aquarat <3090997+aquarat@users.noreply.github.com>

properties:
  compatible:
    const: bosch,bmm350

  reg:
    maxItems: 1

  interrupts:
    maxItems: 1

  vdd-supply: true

  vddio-supply: true

  mount-matrix:
    description: An optional 3x3 mounting rotation matrix.

required:
  - compatible
  - reg

additionalProperties: false

examples:
  - |
    #include <dt-bindings/interrupt-controller/irq.h>
    i2c {
        #address-cells = <1>;
        #size-cells = <0>;

        magnetometer@14 {
            compatible = "bosch,bmm350";
            reg = <0x14>;
            interrupts = <2 IRQ_TYPE_EDGE_RISING>;
        };
    };
```

## dts/bindings/iio/pressure/meas,ms5837.yaml
```yaml
# SPDX-License-Identifier: (GPL-2.0-only OR BSD-2-Clause)
%YAML 1.2
---
$id: http://devicetree.org/schemas/iio/pressure/meas,ms5837.yaml#
$schema: http://devicetree.org/meta-schemas/core.yaml#

title: TE Connectivity MS5837 pressure and temperature sensor

maintainers:
  - aquarat <3090997+aquarat@users.noreply.github.com>

description: |
  A trivial device upstream; this binding adds its supply, which a board may switch.

properties:
  compatible:
    const: meas,ms5837

  reg:
    maxItems: 1

  vdd-supply: true

required:
  - compatible
  - reg

additionalProperties: false

examples:
  - |
    i2c {
        #address-cells = <1>;
        #size-cells = <0>;

        pressure@76 {
            compatible = "meas,ms5837";
            reg = <0x76>;
        };
    };
```

## dts/bindings/mfd/nxp,pca9420.yaml
```yaml
# SPDX-License-Identifier: (GPL-2.0-only OR BSD-2-Clause)
%YAML 1.2
---
$id: http://devicetree.org/schemas/mfd/nxp,pca9420.yaml#
$schema: http://devicetree.org/meta-schemas/core.yaml#

title: NXP PCA9420 power management IC

maintainers:
  - aquarat <3090997+aquarat@users.noreply.github.com>

description:
  Linear battery charger, two buck converters and two LDOs, in four modes. The
  battery being charged is described by a simple-battery node, which gives the
  charge current, the termination current and the charge voltage.

properties:
  compatible:
    const: nxp,pca9420

  reg:
    maxItems: 1

  interrupts:
    maxItems: 1
    description: INTB, an open-drain output, active low.

  monitored-battery:
    $ref: /schemas/types.yaml#/definitions/phandle
    description: The battery being charged, a simple-battery node.

required:
  - compatible
  - reg
  - interrupts
  - monitored-battery

unevaluatedProperties: false

examples:
  - |
    #include <dt-bindings/interrupt-controller/irq.h>

    i2c {
        #address-cells = <1>;
        #size-cells = <0>;

        pmic@61 {
            compatible = "nxp,pca9420";
            reg = <0x61>;
            interrupts = <7 IRQ_TYPE_EDGE_BOTH>;
            monitored-battery = <&battery>;
        };
    };
```

## dts/bindings/mtd/st,stm32u5-flash-controller.yaml
```yaml
# SPDX-License-Identifier: (GPL-2.0-only OR BSD-2-Clause)
%YAML 1.2
---
$id: http://devicetree.org/schemas/mtd/st,stm32u5-flash-controller.yaml#
$schema: http://devicetree.org/meta-schemas/core.yaml#

title: STMicroelectronics STM32U5 embedded flash controller

maintainers:
  - Gerard Marull-Paretas <gerard@teslabs.com>

description:
  Controller that writes and erases the embedded flash, which the CPUs read
  and execute from at its own address. The flash is a child node.

properties:
  compatible:
    const: st,stm32u5-flash-controller

  reg:
    maxItems: 1

  "#address-cells":
    const: 1

  "#size-cells":
    const: 1

patternProperties:
  "^flash@[0-9a-f]+$":
    type: object
    $ref: /schemas/mtd/mtd.yaml#
    description: The embedded flash, at its CPU address.

    properties:
      reg:
        maxItems: 1

    required:
      - reg

    unevaluatedProperties: false

required:
  - compatible
  - reg
  - "#address-cells"
  - "#size-cells"

additionalProperties: false

examples:
  - |
    flash-controller@40022000 {
        compatible = "st,stm32u5-flash-controller";
        reg = <0x40022000 0x400>;
        #address-cells = <1>;
        #size-cells = <1>;

        flash@8000000 {
            reg = <0x08000000 0x400000>;

            partitions {
                compatible = "fixed-partitions";
                #address-cells = <1>;
                #size-cells = <1>;

                partition@0 {
                    label = "code";
                    reg = <0x0 0x100000>;
                };
            };
        };
    };
```

## dts/bindings/net/bluetooth/st,bluenrg-2.yaml
```yaml
# SPDX-License-Identifier: (GPL-2.0-only OR BSD-2-Clause)
%YAML 1.2
---
$id: http://devicetree.org/schemas/net/bluetooth/st,bluenrg-2.yaml#
$schema: http://devicetree.org/meta-schemas/core.yaml#

title: ST BlueNRG-2 Bluetooth LE network processor on SPI

maintainers:
  - aquarat <3090997+aquarat@users.noreply.github.com>

description:
  A BlueNRG-2 running ST's DTM firmware, its SPI variant, used as an HCI
  controller. It frames H4 packets in its own SPI protocol (BlueNRG-2N data
  sheet DS13280, 6.5), with a header giving the room in its buffers, and
  raises IRQ when it is ready for a write or has data to read.

allOf:
  - $ref: /schemas/spi/spi-peripheral-props.yaml#

properties:
  compatible:
    const: st,bluenrg-2

  reg:
    maxItems: 1

  spi-max-frequency:
    maximum: 8000000

  spi-cpha: true

  irq-gpios:
    maxItems: 1
    description: IRQ, high when the chip is ready for a transfer or has data to read.

  reset-gpios:
    maxItems: 1
    description: RESETN.

required:
  - compatible
  - reg
  - spi-cpha
  - irq-gpios
  - reset-gpios

unevaluatedProperties: false

examples:
  - |
    #include <dt-bindings/gpio/gpio.h>

    spi {
        #address-cells = <1>;
        #size-cells = <0>;

        bluetooth@0 {
            compatible = "st,bluenrg-2";
            reg = <0>;
            spi-max-frequency = <1000000>;
            spi-cpha;
            irq-gpios = <&gpioa 9 GPIO_ACTIVE_HIGH>;
            reset-gpios = <&gpioa 8 (GPIO_ACTIVE_LOW | GPIO_OPEN_DRAIN)>;
        };
    };
```

## dts/bindings/power/supply/maxim,max17262.yaml
```yaml
# SPDX-License-Identifier: (GPL-2.0-only OR BSD-2-Clause)
%YAML 1.2
---
$id: http://devicetree.org/schemas/power/supply/maxim,max17262.yaml#
$schema: http://devicetree.org/meta-schemas/core.yaml#

title: Maxim MAX17262 fuel gauge

maintainers:
  - aquarat <3090997+aquarat@users.noreply.github.com>

description:
  Single-cell fuel gauge with an internal current-sense resistor, running the
  ModelGauge m5 EZ algorithm. Its model comes from the battery it monitors, a
  simple-battery node, and from the empty and recovery voltages here.

properties:
  compatible:
    const: maxim,max17262

  reg:
    maxItems: 1

  interrupts:
    maxItems: 1
    description: The ALRT pin, an open-drain alert output.

  monitored-battery:
    $ref: /schemas/types.yaml#/definitions/phandle
    description: The battery being gauged, a simple-battery node.

  maxim,empty-microvolt:
    description: Voltage at which the battery counts as empty under load (VEmpty.VE).
    minimum: 2500000
    maximum: 4000000

  maxim,recovery-microvolt:
    description: Voltage above which the empty detection clears (VEmpty.VR).
    minimum: 2500000
    maximum: 5000000

required:
  - compatible
  - reg
  - monitored-battery
  - maxim,empty-microvolt
  - maxim,recovery-microvolt

additionalProperties: false

examples:
  - |
    i2c {
        #address-cells = <1>;
        #size-cells = <0>;

        fuel-gauge@36 {
            compatible = "maxim,max17262";
            reg = <0x36>;
            monitored-battery = <&battery>;
            maxim,empty-microvolt = <3400000>;
            maxim,recovery-microvolt = <3960000>;
        };
    };
```

## lib/Kconfig
```kconfig
# SPDX-FileCopyrightText: 2026 Core Devices LLC
# SPDX-License-Identifier: Apache-2.0

rsource "c/Kconfig"

menu "Libraries"

config FAT_RO
    bool
    help
      Read the files of the root directory of a FAT16, FAT32 or exFAT
      volume (pbl/fat_ro/fat_ro.h).

config KRAEPELIN
    bool "Kraepelin"
    help
      Build the Kraepelin step and sleep tracking algorithm.

rsource "fuel_gauge/Kconfig"

config VANHEES
    bool "van Hees"
    help
      Build the van Hees wrist angle sleep classifier.

config VFAT
    bool
    help
      A read-only FAT16 volume computed as it is read, from a list of
      files and a callback for their data (pbl/vfat/vfat.h).

endmenu
```

## pebble/apps/Kconfig
```kconfig
# SPDX-FileCopyrightText: 2026 Core Devices LLC
# SPDX-License-Identifier: Apache-2.0

menu "Applications"

rsource "demo/Kconfig"
rsource "prf/Kconfig"
rsource "system/lab/Kconfig"
rsource "system/sport/Kconfig"
rsource "watch/Kconfig"

endmenu
```

## pebble/apps/system/lab/Kconfig
```kconfig
# SPDX-FileCopyrightText: 2026 The unapebble authors
# SPDX-License-Identifier: Apache-2.0

config APP_LAB
    bool "Lab: experiments on the hardware"
    depends on BOOT_TRACE && MMC_STM32_SDMMC && SOC_STM32U5
    select FAT_RO
    select FLASH_BLK_NOR
    help
      A system app listing experiments, each run on demand with its
      steps and results on screen: the reset causes and the boot trace
      of the run before, the clocks, the eMMC step by step and through
      its driver, its NOR window, the update drive and the system
      resources on it, what a firmware with its storage on the eMMC left
      there, the battery's chips read raw, and tests of the trace
      itself. It writes to the eMMC only in its GUI region. For the UNA
      Watch's experiments firmware (unawatch/lab).

config APP_LAB_AUTOSTART
    bool "Open the Lab at boot"
    depends on APP_LAB
    default y
    help
      Open the Lab app on its report of the run before at every boot.
```

## pebble/apps/system/sport/Kconfig
```kconfig
# SPDX-FileCopyrightText: 2026 The unapebble authors
# SPDX-License-Identifier: Apache-2.0

config APP_SPORT
    bool "Sport activity apps (Run, Walk, Bike)"
    help
      Garmin-style Run, Walk and Bike apps on the watch's own sensors:
      GNSS through the location service (CONFIG_SERVICE_LOCATION) when
      the board has it, heart rate, barometer and steps. Activities are
      recorded to the filesystem and exported as FIT files.

if APP_SPORT

config APP_SPORT_FLUSH_S
    int "Seconds of samples buffered"
    default 10
    range 1 27
    help
      Samples are written to the filesystem this often; events at
      once, and whatever is buffered at an orderly restart or
      power-off. A fault, a watchdog reset or a sudden power loss
      loses at most this much.

config APP_SPORT_MAX_ACTIVITIES
    int "Activities kept"
    default 30
    range 2 60
    help
      The oldest are deleted when a new one starts past this many, or
      when the filesystem runs short.

config APP_SPORT_FREE_RESERVE_KIB
    int "Filesystem space left free (KiB)"
    default 1024
    help
      Free space a new segment of an activity leaves in the
      filesystem; older activities are deleted to keep it, and the
      recording ends if that is not enough.

config APP_SPORT_SHELL
    bool "Shell commands"
    default y
    depends on SHELL
    help
      The workout shell command: list the activities, export them as
      FIT files (tools/una/workouts.py), delete them.

endif
```
