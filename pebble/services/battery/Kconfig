## third_party/nimble/transport/Kconfig
```kconfig
# SPDX-FileCopyrightText: 2026 Core Devices LLC
# SPDX-License-Identifier: Apache-2.0

choice NIMBLE_HCI
    prompt "HCI transport"
    default NIMBLE_HCI_FAKE
    help
      How the NimBLE host reaches its controller. The default is derived
      from the SoC (see each soc/<soc>/Kconfig.defconfig); the fake
      controller is the fallback where there is no radio.

config NIMBLE_HCI_NRF52
    bool "NimBLE controller on the nRF52 radio"
    depends on SOC_NRF52
    select NIMBLE_CONTROLLER
    select NIMBLE_DRIVER_NRF5X
    select NIMBLE_TRNG if RNG
    help
      Run the NimBLE link layer in the same image, on the nRF52 radio.
      It takes its random numbers from the RNG driver when there is one,
      as that driver owns the peripheral, and drives the peripheral
      itself otherwise.

config NIMBLE_HCI_SF32LB
    bool "SiFli LCPU over IPC"
    depends on DT_HAS_SIFLI_SF32LB52_LCPU_ENABLED || DT_HAS_SIFLI_SF32LB57_LCPU_ENABLED
    select REMOTEPROC
    help
      Talk H4 HCI to the SiFli controller running on the LCPU, over the
      byte rings its ROM shares with the HCPU.

config NIMBLE_HCI_UART
    bool "H4 over UART"
    depends on QEMU || UART_POSIX_BT_HCI
    help
      Talk H4 HCI to an external controller over the board's BT_HCI_UART.
      On QEMU this is the fourth serial port, on native boards the -b
      option; either can be attached to a host controller such as an
      nRF52840 dongle running an H4 HCI firmware.

config NIMBLE_HCI_BLUENRG2
    bool "ST BlueNRG-2 over SPI"
    depends on DT_HAS_ST_BLUENRG_2_ENABLED
    select BT_HCI
    select BT_HCI_BLUENRG2
    help
      Talk H4 HCI to the board's BlueNRG-2 (the bt_hci role) running
      ST's DTM firmware, in link-layer-only mode, over its SPI protocol.
      The host's HCI_Reset is answered by the transport, as it would
      start the chip's updater.

config NIMBLE_ACI_BLUENRG2
    bool "ST BlueNRG-2's own stack, over its ACI"
    depends on DT_HAS_ST_BLUENRG_2_ENABLED
    select BT_HCI
    select BT_HCI_BLUENRG2
    help
      Run Bluetooth on the stack of the board's BlueNRG-2 (the bt_hci
      role), host included, driven through ST's ACI over its SPI
      protocol, rather than on NimBLE's host. NimBLE's host API is
      provided over the ACI (third_party/nimble/aci), so the Bluetooth
      subsystem runs unchanged; the chip holds the GATT database, the
      pairing and the bonds.

config NIMBLE_HCI_FAKE
    bool "Fake controller"
    help
      Answer every HCI command locally with success and never raise an
      event. The host synchronises and the GATT server runs, but no link
      can be established. For targets without a radio, such as QEMU.

endchoice

config NIMBLE_HCI_THREAD_STACK_SIZE
    int "HCI transport thread stack size in bytes"
    depends on NIMBLE_HCI_SF32LB || NIMBLE_HCI_UART || NIMBLE_HCI_BLUENRG2 || NIMBLE_ACI_BLUENRG2
    default 1536 if NIMBLE_HCI_BLUENRG2 || NIMBLE_ACI_BLUENRG2
    default 1024

config NIMBLE_HCI_THREAD_PRIO
    int "HCI transport thread priority"
    depends on NIMBLE_HCI_SF32LB || NIMBLE_HCI_UART || NIMBLE_HCI_BLUENRG2 || NIMBLE_ACI_BLUENRG2
    default 3

config BLUENRG2_SPI
    bool
    default y if NIMBLE_HCI_BLUENRG2 || NIMBLE_ACI_BLUENRG2
    help
      The BlueNRG-2's SPI protocol and start-up, for its transports.

if NIMBLE_ACI_BLUENRG2

config NIMBLE_ACI_MAX_SVC_DEFS
    int "Service definition arrays"
    default 12
    help
      How many arrays of services ble_gatts_add_svcs() takes.

config NIMBLE_ACI_MAX_CHRS
    int "Characteristics"
    default 32
    help
      How many characteristics the services added to the chip have in
      all, its own GAP and GATT services aside.

config NIMBLE_ACI_MAX_DSCS
    int "Descriptors"
    default 8
    help
      How many descriptors, other than the CCCDs the chip adds itself.

endif

config NIMBLE_DRIVER_NRF5X
    bool
    select HAL_NORDIC

choice NIMBLE_ID_ADDR_SOURCE
    prompt "Identity address"
    default NIMBLE_ID_ADDR_CONTROLLER
    help
      Where the watch's Bluetooth identity address comes from. The default
      is derived from the SoC (see each soc/<soc>/Kconfig.defconfig).

config NIMBLE_ID_ADDR_CONTROLLER
    bool "Controller"
    help
      Use the address the controller reports, or let NimBLE pick one.

config NIMBLE_ID_ADDR_SF32LB_EFUSE
    bool "SF32LB eFUSE"
    depends on SOC_FAMILY_SF32LB && NVMEM_SF32LB
    select NIMBLE_ID_ADDR
    help
      Public address derived from the unique ID in the SoC's eFUSE.

config NIMBLE_ID_ADDR_QEMU
    bool "QEMU machine"
    depends on SOC_QEMU_PEBBLE
    select NIMBLE_ID_ADDR
    help
      Random static address given to the machine at launch, with
      -global pebble-sysctrl.bt-addr=ADDRESS. The controller's address
      is used if none is given.

config NIMBLE_ID_ADDR_BLUENRG2
    bool "BlueNRG-2 static random address"
    depends on NIMBLE_HCI_BLUENRG2 || NIMBLE_ACI_BLUENRG2
    select NIMBLE_ID_ADDR
    help
      The static random address in the BlueNRG-2's configuration data
      (offset 0x80), read by the transport at each start of the chip:
      the address the stock firmware of the UNA Watch gives the watch.
      The chip has no public address.

config NIMBLE_ID_ADDR_POSIX
    bool "Host option"
    depends on SOC_POSIX
    select NIMBLE_ID_ADDR
    help
      Random static address given on the command line, with -a ADDRESS.
      The controller's address is used if none is given.

endchoice

config NIMBLE_ID_ADDR
    bool
    help
      An identity address backend is selected (pbl/bluetooth/id_addr.h).
      The HCI transport programs a public one into its controller.

if NIMBLE_HCI_BLUENRG2
module = NIMBLE_HCI_BLUENRG2
module-str = BlueNRG-2 HCI transport
source "subsys/logging/Kconfig.template.log_level"
endif

if NIMBLE_ACI_BLUENRG2
module = NIMBLE_ACI_BLUENRG2
module-str = NimBLE host API over the BlueNRG-2's ACI
source "subsys/logging/Kconfig.template.log_level"
endif

if BLUENRG2_SPI
module = BLUENRG2_SPI
module-str = BlueNRG-2 SPI protocol
source "subsys/logging/Kconfig.template.log_level"
endif
```
