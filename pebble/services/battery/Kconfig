## pebble/services/battery/Kconfig
```kconfig
# SPDX-FileCopyrightText: 2026 Core Devices LLC
# SPDX-FileCopyrightText: 2026 The unapebble authors
# SPDX-License-Identifier: Apache-2.0

config SERVICE_BATTERY
    bool "Battery"
    help
      Battery monitor and state-of-charge estimation.

choice BATTERY_SOC
    prompt "State-of-charge estimation"
    default BATTERY_SOC_GAUGE if GAUGE
    default NRF_FUEL_GAUGE if CHARGER_NPM1300
    default BATTERY_SOC_VOLTAGE

config BATTERY_SOC_VOLTAGE
    bool "Voltage curve"
    help
      Look the state of charge up in a voltage curve.

config NRF_FUEL_GAUGE
    bool "Nordic nRF Fuel Gauge"
    depends on CHARGER_NPM1300
    help
      Use the Nordic nRF Fuel Gauge library for state-of-charge
      estimation. Requires the nPM1300 PMIC; selects both the prebuilt
      nonfree fuel-gauge lib and the matching battery service impl.

config BATTERY_SOC_FUEL_GAUGE
    bool "Fuel gauge"
    depends on CHARGER_NPM1300
    depends on BATTERY_SIMPLE
    select FUEL_GAUGE
    help
      Use the open fuel gauge (lib/fuel_gauge), with the capacity, the
      internal resistance and the open-circuit voltage curve of the battery
      in the devicetree.

config BATTERY_SOC_GAUGE
    bool "Fuel gauge chip"
    depends on GAUGE
    help
      Take the state of charge from the board's fuel gauge chip
      (pbl/drivers/gauge.h), and allow charging only while it reads a
      battery temperature between 0 and 45 degrees C.

endchoice

if SERVICE_BATTERY

config SERVICE_BATTERY_LOW_POWER_PERCENT
    int "Low power threshold (%)"
    range 1 100
    default 2
    help
      Battery percentage below which the watch enters low power mode.

config SERVICE_BATTERY_CAPACITY_HOURS
    int "Battery life (hours)"
    range 1 65535
    default 168
    help
      Approximate hours of battery life on a full charge, used to convert
      between charge percentage and remaining time.

config BATTERY_WARNING_FIRST_PERCENT
    int "First battery warning threshold (%)"
    range 0 100
    default 0
    help
      Battery percentage for the first warning. A value of 0 uses the
      default time-based threshold of 18 hours remaining.

config BATTERY_WARNING_SECOND_PERCENT
    int "Second battery warning threshold (%)"
    range 0 100
    default 0
    help
      Battery percentage for the second warning. A value of 0 uses the
      default time-based threshold of 12 hours remaining.

config BATTERY_TEST
    bool "Battery capacity test"
    depends on BATTERY_SOC_GAUGE
    help
      The Battery test app and its logger: charges to full, discharges
      to the low battery power-off and charges again, counting the
      charge with the fuel gauge's coulomb counter and an integral of
      its current. Logs to the filesystem across the power-off; the
      "battery test" shell commands print the log and the results.

module = SERVICE_BATTERY
module-str = Battery
source "subsys/logging/Kconfig.template.log_level"

endif
```

## pebble/services/dev_usb/Kconfig
```kconfig
# SPDX-FileCopyrightText: 2026 The unapebble authors
# SPDX-License-Identifier: Apache-2.0

config DEV_USB
    bool "USB developer access"
    default y if BOARD_UNAWATCH && !BOARD_UNAWATCH_LAB && (!RELEASE || BOARD_UNAWATCH_TETHER_SLOT)
    depends on BOARD_UNAWATCH
    select USB_DEVICE
    select USB_CDC_ACM
    select KERNEL_SYS_WORKQ
    help
      Two serial ports on the USB-C connector, behind the "USB developer"
      toggle of Settings > System > Debugging (off by default): the
      console, with the logs and the shell, and the tether protocol of
      tools/una/tether, which tether.py speaks to the stub too. Whoever
      plugs a cable in while it is on can read and write memory: see the
      decision log (docs/boards/unawatch/decisions). The USB is powered
      up only while the toggle is on and, unless DEV_USB_FOLLOW_VBUS is
      off, the watch is plugged in.

if DEV_USB

config DEV_USB_FORCE
    bool "Always on"
    default y if BOARD_UNAWATCH_TETHER_SLOT
    help
      The developer access stays on whatever the toggle says, plugged in
      or not. For images linked for the tether stub's slot, flashed and
      started through the stub, which grants the same access: the host
      that flashed one keeps its console and its tether port across
      settings that would turn them off.

config DEV_USB_FOLLOW_VBUS
    bool "Only while plugged in"
    default y
    depends on !DEV_USB_FORCE
    help
      Power the USB up only while the charger sees an input, as the
      PMIC reports it, and down at the unplug: the PHY and the 16 MHz
      crystal draw nothing on battery.

config DEV_USB_TETHER
    bool "Tether protocol"
    default y
    depends on SOC_STM32U5
    help
      The tether stub's protocol (tools/una/tether/stub/proto.c, built
      from there) on the second port: info, memory reads and writes,
      fill and CRC, I2C and GPIO, with the stub's refusals, notes, and
      reset and power-off. Calls of code and flashing are left to the
      stub: tether.py goes through a reset to it to flash.

config DEV_USB_THREAD_PRIO
    int "Tether thread priority"
    default 2
    depends on DEV_USB_TETHER

module = DEV_USB
module-str = USB developer access
source "subsys/logging/Kconfig.template.log_level"

endif # DEV_USB
```

## pebble/services/location/Kconfig
```kconfig
# SPDX-FileCopyrightText: 2026 Core Devices LLC
# SPDX-FileCopyrightText: 2026 The unapebble authors
# SPDX-License-Identifier: Apache-2.0

config SERVICE_LOCATION
    bool "Location"
    depends on GNSS
    help
      On-watch location service, positioning with the GNSS receiver
      (CONFIG_GNSS) for the system apps.

if SERVICE_LOCATION

config SERVICE_LOCATION_SET_CLOCK
    bool "Set the clock from the GNSS"
    default y
    depends on SERVICE_ACTIVITY
    help
      Set the clock from the receiver's UTC when it is more than 2 s
      off, from a time two epochs a second apart agree on or one of a
      fix, at most once an hour, and never while a workout runs, which
      times itself on the clock. For watches without a phone to set it.

module = SERVICE_LOCATION
module-str = Location
source "subsys/logging/Kconfig.template.log_level"

endif
```

## pebble/services/usb_drive/Kconfig
```kconfig
# SPDX-FileCopyrightText: 2026 The unapebble authors
# SPDX-License-Identifier: Apache-2.0

config USB_DRIVE
    bool "Workouts as a USB drive"
    default y if BOARD_UNAWATCH && !BOARD_UNAWATCH_LAB && APP_SPORT
    depends on APP_SPORT
    select USB_DEVICE
    select USB_MSC
    select VFAT
    select SERVICE_USB_POWER
    select KERNEL_SYS_WORKQ
    help
      Plugged into a computer, the watch shows a read-only USB drive of
      FIT files, one for each finished workout, encoded from the
      journals as the computer reads them, nothing of it stored. On by
      default, the "USB drive" toggle of Settings > System. See the
      decision log (docs/boards/unawatch/decisions).

if USB_DRIVE

module = USB_DRIVE
module-str = Workouts USB drive
source "subsys/logging/Kconfig.template.log_level"

endif
```

## pebble/services/usb_power/Kconfig
```kconfig
# SPDX-FileCopyrightText: 2026 The unapebble authors
# SPDX-License-Identifier: Apache-2.0

config SERVICE_USB_POWER
    bool
    select USB_DEVICE
    select KERNEL_SYS_WORKQ
    help
      The USB device up while one of its users wants it: the developer
      access, the drive (pbl/services/usb_power.h).

if SERVICE_USB_POWER

module = SERVICE_USB_POWER
module-str = USB power
source "subsys/logging/Kconfig.template.log_level"

endif
```

## soc/st/stm32u5/Kconfig
```kconfig
# SPDX-FileCopyrightText: 2026 Core Devices LLC
# SPDX-License-Identifier: Apache-2.0

config SOC_STM32U5
    bool
    select SOC_FAMILY_STM32
    select SOC_HAS_UNIQUE_ID
    select CPU_CORTEX_M33
    select ARMV8_M_DSP
    select CPU_HAS_FPU
    select PINCTRL
    select SOC_HAS_IDLE_STATES
    select SOC_HAS_POWER_OFF
    select TIMER_STM32_LPTIM
    help
      ST STM32U5 series, selected by its SoCs. The Cortex-M33 runs
      non-secure, TrustZone off, as the UNA Watch bootloader leaves it.

if SOC_STM32U5

config SOC_STM32U5_ICACHE
    bool "Instruction cache"
    default y
    help
      Turn the ICACHE on at boot, in front of the code bus: the flash runs
      with 4 wait states at 160 MHz.

config SOC_STM32U5_BKP_POWER_OFF
    int "Backup register of the bootloader power-off flag"
    default 3
    range -1 31
    help
      TAMP backup register in which power-off sets 1, which tells the UNA
      Watch bootloader that the watch was powered off: it then powers the
      watch off again, unless the power button is held. -1 for none.

config SOC_STM32U5_EARLY_PLL1_OFF
    bool "Turn PLL1 off at the start of boot"
    default y
    help
      Turn PLL1 off as soon as the system clock runs on MSIS, before the
      devices come up, whatever the bootloader left running on it. The
      clock tree turns PLL1 off anyway before it sets it up, so this only
      moves that earlier. Off, PLL1 runs as the bootloader left it until
      the clock tree starts, as in the first UNA Watch images.

endif # SOC_STM32U5
```

## soc/st/stm32u5/Kconfig.soc
```kconfig
# SPDX-FileCopyrightText: 2026 Core Devices LLC
# SPDX-License-Identifier: Apache-2.0

config SOC_STM32U5A5
    bool "ST STM32U5A5"
    select SOC_STM32U5
    help
      The STM32U5A5, with the cryptographic accelerators of the STM32U5
      series and up to 4 MiB of flash.
```

## subsys/boot_trace/Kconfig
```kconfig
# SPDX-FileCopyrightText: 2026 The unapebble authors
# SPDX-License-Identifier: Apache-2.0

menuconfig BOOT_TRACE
    bool "Boot trace"
    depends on SOC_STM32U5
    help
      Breadcrumbs and fault records that survive a reset, for a watch
      without a console (pbl/boot_trace/boot_trace.h): the last
      breadcrumb in a TAMP backup register, which survives any reset and
      the bootloader installing another image, and the last ones with
      their uptime, the last CPU fault and the last panic in a record in
      RAM, which survives a reset. The next boot keeps the record of the
      run before for a viewer, the Lab app.

if BOOT_TRACE

config BOOT_TRACE_RAM_BASE
    hex "Address of the RAM record"
    help
      A region of SRAM the firmware does not otherwise use, reserved in
      the board's devicetree, that the bootloader leaves alone.

config BOOT_TRACE_RAM_SIZE
    hex "Size of the RAM record"
    default 0x400

config BOOT_TRACE_BKP_CRUMB
    int "Backup register of the last breadcrumb"
    default 30
    range 24 31

config BOOT_TRACE_BKP_BOOT
    int "Backup register of the boot count"
    default 31
    range 24 31

config BOOT_TRACE_IMAGE
    string "Name of the image, kept in the record"
    default "pebble"

config BOOT_TRACE_IMAGE_ID
    int "Number of the image, kept in the backup register"
    default 0
    range 0 15

config BOOT_TRACE_BOOT_PATH
    bool "Breadcrumbs along the boot path"
    help
      Breadcrumbs in the stages of the boot, the MMC and its driver, the
      NOR window, the filesystem's mount and format, and the system
      resources' check and copy, so that a firmware that resets during
      its boot can be followed.

endif # BOOT_TRACE
```
